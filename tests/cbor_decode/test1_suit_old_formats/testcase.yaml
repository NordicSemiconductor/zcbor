## tests/cbor_decode/test1_suit_old_formats/testcase.yaml
```yaml
tests:
  zcbor.cbor_decode.test1_suit_old_formats:
    platform_allow: native_posix native_posix_64
    tags: zcbor cbor_decode
```

## tests/cbor_decode/test2_suit/testcase.yaml
```yaml
tests:
  zcbor.cbor_decode.test2_suit:
    platform_allow: native_posix native_posix_64
    tags: zcbor cbor_decode
```

## tests/cbor_decode/test3_simple/testcase.yaml
```yaml
tests:
  zcbor.cbor_decode.test3_simple:
    platform_allow: native_posix native_posix_64
    tags: zcbor cbor_decode
```

## tests/cbor_decode/test5_strange/testcase.yaml
```yaml
tests:
  cddl_gen.cbor_decode.test5_strange:
    platform_allow: native_posix native_posix_64
    tags: cddl_gen cbor_decode
  cddl_gen.cbor_decode.test5_strange.indeterminate_length_arrays:
    platform_allow: native_posix native_posix_64
    tags: cddl_gen cbor_decode
    extra_args: TEST_INDETERMINATE_LENGTH_ARRAYS=1
```

## tests/cbor_decode/test7_suit9_simple/testcase.yaml
```yaml
tests:
  zcbor.cbor_decode.test7_suit9_simple:
    platform_allow: native_posix native_posix_64
    tags: zcbor cbor_decode
```

## tests/cbor_decode/test8_suit12/testcase.yaml
```yaml
tests:
  cddl_gen.cbor_decode.test8_suit12:
    platform_allow: native_posix native_posix_64
    tags: cddl_gen cbor_decode
```

## tests/cbor_decode/test9_manifest14/testcase.yaml
```yaml
tests:
  zcbor.cbor_decode.test9_manifest14:
    platform_allow: native_posix native_posix_64
    tags: zcbor cbor_decode
```

## tests/cbor_encode/test1_suit/testcase.yaml
```yaml
tests:
  zcbor.cbor_encode.test1_suit.canonical:
    platform_allow: native_posix native_posix_64
    tags: zcbor cbor_encode canonical
    extra_args: CANONICAL=CANONICAL
```

## tests/cbor_encode/test2_simple/testcase.yaml
```yaml
tests:
  zcbor.cbor_encode.test2_simple:
    platform_allow: native_posix native_posix_64
    tags: zcbor cbor_encode
  zcbor.cbor_encode.test2_simple.canonical:
    platform_allow: native_posix native_posix_64
    tags: zcbor cbor_encode canonical
    extra_args: CANONICAL=CANONICAL
```

## tests/cbor_encode/test3_strange/testcase.yaml
```yaml
tests:
  zcbor.cbor_encode.test3_strange:
    platform_allow: native_posix native_posix_64
    tags: zcbor cbor_encode
  zcbor.cbor_encode.test3_strange.canonical:
    platform_allow: native_posix native_posix_64
    tags: zcbor cbor_encode
    extra_args: CANONICAL=CANONICAL
```

## tests/decode/test1_suit_old_formats/testcase.yaml
```yaml
tests:
  zcbor.decode.test1_suit_old_formats:
    platform_allow: native_posix native_posix_64 mps2/an521/cpu0 qemu_malta_be
    tags: zcbor decode test1
```

## tests/decode/test2_suit/testcase.yaml
```yaml
tests:
  zcbor.decode.test2_suit:
    platform_allow: native_posix native_posix_64 mps2/an521/cpu0 qemu_malta_be
    tags: zcbor decode test2
```

## tests/decode/test3_simple/testcase.yaml
```yaml
tests:
  zcbor.decode.test3_simple:
    platform_allow: native_posix native_posix_64 mps2/an521/cpu0 qemu_malta_be
    tags: zcbor decode test3
```

## tests/decode/test5_corner_cases/testcase.yaml
```yaml
tests:
  zcbor.decode.test5_corner_cases:
    platform_allow:
      - native_sim
      - native_sim/native/64
      - mps2/an521/cpu0
      - qemu_malta/qemu_malta/be
    tags:
      - zcbor
      - decode
      - test5
    extra_args: CANONICAL=1
  zcbor.decode.test5_corner_cases.indefinite_length_arrays:
    platform_allow:
      - native_sim
      - native_sim/native/64
      - mps2/an521/cpu0
      - qemu_malta/qemu_malta/be
    tags:
      - zcbor
      - decode
      - test5
      - indefinite
    extra_args: TEST_INDEFINITE_LENGTH_ARRAYS=1
```

## tests/decode/test5_strange/testcase.yaml
```yaml
tests:
  zcbor.decode.test5_strange:
    platform_allow: native_posix native_posix_64
    tags: zcbor decode
  zcbor.decode.test5_strange.indeterminate_length_arrays:
    platform_allow: native_posix native_posix_64
    tags: zcbor decode
    extra_args: TEST_INDETERMINATE_LENGTH_ARRAYS=1
```

## tests/decode/test7_suit9_simple/testcase.yaml
```yaml
tests:
  zcbor.decode.test7_suit9_simple:
    platform_allow: native_posix native_posix_64 mps2/an521/cpu0 qemu_malta_be
    tags: zcbor decode test7
```

## tests/decode/test8_suit12/testcase.yaml
```yaml
tests:
  zcbor.decode.test8_suit12:
    platform_allow:
      - native_sim
      - native_sim/native/64
      - mps2/an521/cpu0
      - qemu_malta/qemu_malta/be
    tags:
      - zcbor
      - decode
      - test8
```

## tests/decode/test9_manifest14/testcase.yaml
```yaml
tests:
  zcbor.decode.test9_manifest14:
    platform_allow: native_posix native_posix_64 mps2_an521 qemu_malta_be
    tags: zcbor decode manifest14 test9
  zcbor.cbor_decode.test9_manifest16:
    platform_allow: native_posix native_posix_64 mps2_an521 qemu_malta_be
    tags: zcbor decode manifest16 test9
    extra_args: MANIFEST=manifest16
```

## tests/decode/testA_unordered_map/testcase.yaml
```yaml
tests:
  zcbor.decode.testA_unordered_map:
    platform_allow: native_posix native_posix_64 mps2_an521 qemu_malta_be
    tags: zcbor decode unordered_map testA
```

## tests/encode/test1_suit/testcase.yaml
```yaml
tests:
  zcbor.encode.test1_suit.canonical:
    platform_allow: native_posix native_posix_64 mps2_an521 qemu_malta_be
    tags: zcbor encode canonical test1
    extra_args: CANONICAL=CANONICAL
```

## tests/encode/test2_simple/testcase.yaml
```yaml
tests:
  zcbor.encode.test2_simple:
    platform_allow: native_posix native_posix_64
    tags: zcbor encode
  zcbor.encode.test2_simple.canonical:
    platform_allow: native_posix native_posix_64
    tags: zcbor encode canonical
    extra_args: CANONICAL=CANONICAL
```

## tests/encode/test3_corner_cases/testcase.yaml
```yaml
tests:
  zcbor.encode.test3_corner_cases:
    platform_allow: native_posix native_posix_64
    tags: zcbor encode
  zcbor.encode.test3_corner_cases.canonical:
    platform_allow: native_posix native_posix_64
    tags: zcbor encode
    extra_args: CANONICAL=CANONICAL
```

## tests/encode/test3_strange/testcase.yaml
```yaml
tests:
  zcbor.encode.test3_strange:
    platform_allow: native_posix native_posix_64
    tags: zcbor encode
  zcbor.encode.test3_strange.canonical:
    platform_allow: native_posix native_posix_64
    tags: zcbor encode
    extra_args: CANONICAL=CANONICAL
```

## tests/encode/test4_senml/testcase.yaml
```yaml
tests:
  zcbor.encode.test4_senml:
    platform_allow: native_posix native_posix_64 mps2/an521/cpu0 qemu_malta_be
    tags: zcbor encode test4
  zcbor.encode.test4_senml.canonical:
    platform_allow: native_posix native_posix_64 mps2/an521/cpu0 qemu_malta_be
    tags: zcbor encode canonical test4
    extra_args: CANONICAL=CANONICAL
```

## tests/unit/test1_unit_tests/testcase.yaml
```yaml
tests:
  zcbor.unit.test1:
    platform_allow: native_posix native_posix_64 mps2_an521
    tags: zcbor unit
```
