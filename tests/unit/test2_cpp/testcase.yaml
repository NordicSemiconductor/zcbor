## tests/unit/test2_cpp/testcase.yaml
```yaml
tests:
  zcbor.unit.test2:
    platform_allow: mps2/an521/cpu0 qemu_malta_be
    tags: zcbor unit cpp
common: 
  harness: console
  harness_config:
    type: multi_line
    regex:
      - "Success!"
```
