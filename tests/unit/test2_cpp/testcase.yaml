## tests/unit/test4_print_cbor/testcase.yaml
```yaml
tests:
  zcbor.unit.test4_print_cbor:
    # Note: mps2_an521 sometimes faults during printing and so is excluded here
    # I don't know why, but I think it's unrelated.
    platform_allow: native_posix qemu_malta_be
    extra_args: ZCBOR_PRINT_CBOR=ON
    tags: zcbor unit test4 print_cbor no_verbose
    timeout: 10
    harness: console
    harness_config:
      type: multi_line
      regex:
       - '0x9f \(start\)'
       - '\| 0x00 \(0\)'
       - '\| 0x19 12 34 \(4660\)'
       - '\| 0x1b 00 00 00 02 4c b0 16 ea \(9876543210\)'
       - '\| 0x58 20 \(32\)'
       - '\| \| 0x01 23 45 67 89 ab cd ef fe dc ba 98 76 54 32 10'
       - '\| \| 0x00 11 22 33 44 55 66 77 88 99 aa bb cc dd ee ff'
       - '\| 0x6b \(11\)'
       - '"Hello World"'
       - '\| 0x09 0x1234 0xf5 \(21\)'
       - '\| 0xf4 \(20\)'
       - '\| 0xf9 42 48 \(16968\)'
       - '\| 0xfa 41 28 00 00 \(1093140480\)'
       - '\| 0xfb 40 29 66 66 66 66 66 66 \(4623339082463209062\)'
       - '\| 0xf6 \(22\)'
       - '\| 0xf7 \(23\)'
       - '\| 0x40 \(0\)'
       - '\| 0x9f \(start\)'
       - '\| \| 0xbf \(start\)'
       - '\| \| \| 0x64 \(4\)'
       - '"Key0"'
       - '\| \| \| 0xfa 00 00 00 00 \(0\)'
       - '\| \| \| 0x01 \(1\)'
       - '\| \| \| 0x66 \(6\)'
       - '"Value1"'
       - '\| \| 0xff \(end\)'
       - '\| 0xff \(end\)'
       - '0xff \(end\)'
       - '0x6b 0xa4 \(4\)'
       - '\| 0x02 \(2\)'
       - '\| 0x58 73 \(115\)'
       - '\| \| 0x82 58 24 82 2f 58 20 86 bb cc 88 23 f3 a4 44 19'
       - '\| \| 0x56 f0 2b 00 13 02 f5 03 48 74 61 fb 77 fa b0 86'
       - '\| \| 0xef e3 15 30 88 1f 97 58 4a d2 84 43 a1 01 26 a0'
       - '\| \| 0xf6 58 40 8c 6b f0 14 b6 2f a7 b8 0d d5 eb 2f f7'
       - '\| \| 0x02 4a b5 2a 11 6c d1 bc 0d b1 f1 03 11 b3 1e 7b'
       - '\| \| 0x29 e3 be ae 76 5f ad 42 fb 86 00 fa 13 a6 bf 6d'
       - '\| \| 0x5e 45 92 9a 05 a6 07 67 f9 b7 42 0a 50 02 a0 5d'
       - '\| \| 0x95 e4 9e'
       - '\| \| 0x82 \(2\)'
       - '\| \| \| 0x58 24 \(36\)'
       - '\| \| \| \| 0x82 2f 58 20 86 bb cc 88 23 f3 a4 44 19 56 f0 2b'
       - '\| \| \| \| 0x00 13 02 f5 03 48 74 61 fb 77 fa b0 86 ef e3 15'
       - '\| \| \| \| 0x30 88 1f 97'
       - '\| \| \| \| 0x82 \(2\)'
       - '\| \| \| \| \| 0x2f \(15\)'
       - '\| \| \| \| \| 0x58 20 \(32\)'
       - '\| \| \| \| \| \| 0x86 bb cc 88 23 f3 a4 44 19 56 f0 2b 00 13 02 f5'
       - '\| \| \| \| \| \| 0x03 48 74 61 fb 77 fa b0 86 ef e3 15 30 88 1f 97'
       - '\| \| \| 0x58 4a \(74\)'
       - '\| \| \| \| 0xd2 84 43 a1 01 26 a0 f6 58 40 8c 6b f0 14 b6 2f'
       - '\| \| \| \| 0xa7 b8 0d d5 eb 2f f7 02 4a b5 2a 11 6c d1 bc 0d'
       - '\| \| \| \| 0xb1 f1 03 11 b3 1e 7b 29 e3 be ae 76 5f ad 42 fb'
       - '\| \| \| \| 0x86 00 fa 13 a6 bf 6d 5e 45 92 9a 05 a6 07 67 f9'
       - '\| \| \| \| 0xb7 42 0a 50 02 a0 5d 95 e4 9e'
       - '\| \| \| \| 0x12 0x84 \(4\)'
       - '\| \| \| \| \| 0x43 \(3\)'
       - '\| \| \| \| \| \| 0xa1 \(1\)'
       - '\| \| \| \| \| \| \| 0x01 \(1\)'
       - '\| \| \| \| \| \| \| 0x26 \(6\)'
       - '\| \| \| \| \| 0xa0 \(0\)'
       - '\| \| \| \| \| 0xf6 \(22\)'
       - '\| \| \| \| \| 0x58 40 \(64\)'
       - '\| \| \| \| \| \| 0x8c 6b f0 14 b6 2f a7 b8 0d d5 eb 2f f7 02 4a b5'
       - '\| \| \| \| \| \| 0x2a 11 6c d1 bc 0d b1 f1 03 11 b3 1e 7b 29 e3 be'
       - '\| \| \| \| \| \| 0xae 76 5f ad 42 fb 86 00 fa 13 a6 bf 6d 5e 45 92'
       - '\| \| \| \| \| \| 0x9a 05 a6 07 67 f9 b7 42 0a 50 02 a0 5d 95 e4 9e'
       - '\| 0x03 \(3\)'
       - '\| 0x58 bb \(187\)'
       - '\| \| 0xa7 01 01 02 02 03 58 5f a2 02 81 81 41 00 04 58'
       - '\| \| 0x56 86 14 a4 01 50 fa 6b 4a 53 d5 ad 5f df be 9d'
       - '\| \| 0xe6 63 e4 d4 1f fe 02 50 14 92 af 14 25 69 5e 48'
       - '\| \| 0xbf 42 9b 2d 51 f2 ab 45 03 58 24 82 2f 58 20 00'
       - '\| \| 0x11 22 33 44 55 66 77 88 99 aa bb cc dd ee ff 01'
       - '\| \| 0x23 45 67 89 ab cd ef fe dc ba 98 76 54 32 10 0e'
       - '\| \| 0x19 87 d0 01 0f 02 0f 07 43 82 03 0f 09 43 82 17'
       - '\| \| 0x02 11 82 2f 58 20 cf a9 0c 5c 58 59 5e 7f 51 19'
       - '\| \| 0xa7 2f 80 3f d0 37 0b 3e 6a bb ec 63 15 cd 38 f6'
       - '\| \| 0x31 35 28 1b c4 98 17 82 2f 58 20 2b fc 4d 0c c6'
       - '\| \| 0x68 0b e7 dd 9f 5c a3 0a a2 bb 5d 19 98 14 5d e3'
       - '\| \| 0x3d 54 10 1b 80 e2 ca 49 fa f9 18'
       - '\| \| 0xa7 \(7\)'
       - '\| \| \| 0x01 \(1\)'
       - '\| \| \| 0x01 \(1\)'
       - '\| \| \| 0x02 \(2\)'
       - '\| \| \| 0x02 \(2\)'
       - '\| \| \| 0x03 \(3\)'
       - '\| \| \| 0x58 5f \(95\)'
       - '\| \| \| \| 0xa2 02 81 81 41 00 04 58 56 86 14 a4 01 50 fa 6b'
       - '\| \| \| \| 0x4a 53 d5 ad 5f df be 9d e6 63 e4 d4 1f fe 02 50'
       - '\| \| \| \| 0x14 92 af 14 25 69 5e 48 bf 42 9b 2d 51 f2 ab 45'
       - '\| \| \| \| 0x03 58 24 82 2f 58 20 00 11 22 33 44 55 66 77 88'
       - '\| \| \| \| 0x99 aa bb cc dd ee ff 01 23 45 67 89 ab cd ef fe'
       - '\| \| \| \| 0xdc ba 98 76 54 32 10 0e 19 87 d0 01 0f 02 0f'
       - '\| \| \| \| 0xa2 \(2\)'
       - '\| \| \| \| \| 0x02 \(2\)'
       - '\| \| \| \| \| 0x81 \(1\)'
       - '\| \| \| \| \| \| 0x81 \(1\)'
       - '\| \| \| \| \| \| \| 0x41 \(1\)'
       - '\| \| \| \| \| \| \| \| 0x00 \(0\)'
       - '\| \| \| \| \| 0x04 \(4\)'
       - '\| \| \| \| \| 0x58 56 \(86\)'
       - '\| \| \| \| \| \| 0x86 14 a4 01 50 fa 6b 4a 53 d5 ad 5f df be 9d e6'
       - '\| \| \| \| \| \| 0x63 e4 d4 1f fe 02 50 14 92 af 14 25 69 5e 48 bf'
       - '\| \| \| \| \| \| 0x42 9b 2d 51 f2 ab 45 03 58 24 82 2f 58 20 00 11'
       - '\| \| \| \| \| \| 0x22 33 44 55 66 77 88 99 aa bb cc dd ee ff 01 23'
       - '\| \| \| \| \| \| 0x45 67 89 ab cd ef fe dc ba 98 76 54 32 10 0e 19'
       - '\| \| \| \| \| \| 0x87 d0 01 0f 02 0f'
       - '\| \| \| \| \| \| 0x86 \(6\)'
       - '\| \| \| \| \| \| \| 0x14 \(20\)'
       - '\| \| \| \| \| \| \| 0xa4 \(4\)'
       - '\| \| \| \| \| \| \| \| 0x01 \(1\)'
       - '\| \| \| \| \| \| \| \| 0x50 \(16\)'
       - '\| \| \| \| \| \| \| \| \| 0xfa 6b 4a 53 d5 ad 5f df be 9d e6 63 e4 d4 1f fe'
       - '\| \| \| \| \| \| \| \| 0x02 \(2\)'
       - '\| \| \| \| \| \| \| \| 0x50 \(16\)'
       - '\| \| \| \| \| \| \| \| \| 0x14 92 af 14 25 69 5e 48 bf 42 9b 2d 51 f2 ab 45'
       - '\| \| \| \| \| \| \| \| 0x03 \(3\)'
       - '\| \| \| \| \| \| \| \| 0x58 24 \(36\)'
       - '\| \| \| \| \| \| \| \| \| 0x82 2f 58 20 00 11 22 33 44 55 66 77 88 99 aa bb'
       - '\| \| \| \| \| \| \| \| \| 0xcc dd ee ff 01 23 45 67 89 ab cd ef fe dc ba 98'
       - '\| \| \| \| \| \| \| \| \| 0x76 54 32 10'
       - '\| \| \| \| \| \| \| \| \| 0x82 \(2\)'
       - '\| \| \| \| \| \| \| \| \| \| 0x2f \(15\)'
       - '\| \| \| \| \| \| \| \| \| \| 0x58 20 \(32\)'
       - '\| \| \| \| \| \| \| \| \| \| \| 0x00 11 22 33 44 55 66 77 88 99 aa bb cc dd ee ff'
       - '\| \| \| \| \| \| \| \| \| \| \| 0x01 23 45 67 89 ab cd ef fe dc ba 98 76 54 32 10'
       - '\| \| \| \| \| \| \| \| 0x0e \(14\)'
       - '\| \| \| \| \| \| \| \| 0x19 87 d0 \(34768\)'
       - '\| \| \| \| \| \| \| 0x01 \(1\)'
       - '\| \| \| \| \| \| \| 0x0f \(15\)'
       - '\| \| \| \| \| \| \| 0x02 \(2\)'
       - '\| \| \| \| \| \| \| 0x0f \(15\)'
       - '\| \| \| 0x07 \(7\)'
       - '\| \| \| 0x43 \(3\)'
       - '\| \| \| \| 0x82 \(2\)'
       - '\| \| \| \| \| 0x03 \(3\)'
       - '\| \| \| \| \| 0x0f \(15\)'
       - '\| \| \| 0x09 \(9\)'
       - '\| \| \| 0x43 \(3\)'
       - '\| \| \| \| 0x82 \(2\)'
       - '\| \| \| \| \| 0x17 \(23\)'
       - '\| \| \| \| \| 0x02 \(2\)'
       - '\| \| \| 0x11 \(17\)'
       - '\| \| \| 0x82 \(2\)'
       - '\| \| \| \| 0x2f \(15\)'
       - '\| \| \| \| 0x58 20 \(32\)'
       - '\| \| \| \| \| 0xcf a9 0c 5c 58 59 5e 7f 51 19 a7 2f 80 3f d0 37'
       - '\| \| \| \| \| 0x0b 3e 6a bb ec 63 15 cd 38 f6 31 35 28 1b c4 98'
       - '\| \| \| 0x17 \(23\)'
       - '\| \| \| 0x82 \(2\)'
       - '\| \| \| \| 0x2f \(15\)'
       - '\| \| \| \| 0x58 20 \(32\)'
       - '\| \| \| \| \| 0x2b fc 4d 0c c6 68 0b e7 dd 9f 5c a3 0a a2 bb 5d'
       - '\| \| \| \| \| 0x19 98 14 5d e3 3d 54 10 1b 80 e2 ca 49 fa f9 18'
       - '\| 0x11 \(17\)'
       - '\| 0x58 3c \(60\)'
       - '\| \| 0x86 14 a1 15 78 32 68 74 74 70 3a 2f 2f 65 78 61'
       - '\| \| 0x6d 70 6c 65 2e 63 6f 6d 2f 76 65 72 79 2f 6c 6f'
       - '\| \| 0x6e 67 2f 70 61 74 68 2f 74 6f 2f 66 69 6c 65 2f'
       - '\| \| 0x66 69 6c 65 2e 62 69 6e 15 02 03 0f'
       - '\| \| 0x86 \(6\)'
       - '\| \| \| 0x14 \(20\)'
       - '\| \| \| 0xa1 \(1\)'
       - '\| \| \| \| 0x15 \(21\)'
       - '\| \| \| \| 0x78 32 \(50\)'
       - '"http://example.com/very/long/path/to/file/file\.bin"'
       - '\| \| \| 0x15 \(21\)'
       - '\| \| \| 0x02 \(2\)'
       - '\| \| \| 0x03 \(3\)'
       - '\| \| \| 0x0f \(15\)'
       - '\| 0x17 \(23\)'
       - '\| 0x59 02 04 \(516\)'
       - '\| \| 0xa2 01 79 01 9d 23 23 20 45 78 61 6d 70 6c 65 20'
       - '\| \| 0x32 3a 20 53 69 6d 75 6c 74 61 6e 65 6f 75 73 20'
       - '\| \| 0x44 6f 77 6e 6c 6f 61 64 2c 20 49 6e 73 74 61 6c'
       - '\| \| 0x6c 61 74 69 6f 6e 2c 20 53 65 63 75 72 65 20 42'
       - '\| \| 0x6f 6f 74 2c 20 53 65 76 65 72 65 64 20 46 69 65'
       - '\| \| 0x6c 64 73 0a 0a 20 20 20 20 54 68 69 73 20 65 78'
       - '\| \| 0x61 6d 70 6c 65 20 63 6f 76 65 72 73 20 74 68 65'
       - '\| \| 0x20 66 6f 6c 6c 6f 77 69 6e 67 20 74 65 6d 70 6c'
       - '\| \| 0x61 74 65 73 3a 0a 20 20 20 20 0a 20 20 20 20 2a'
       - '\| \| 0x20 43 6f 6d 70 61 74 69 62 69 6c 69 74 79 20 43'
       - '\| \| 0x68 65 63 6b 20 28 7b 7b 74 65 6d 70 6c 61 74 65'
       - '\| \| 0x2d 63 6f 6d 70 61 74 69 62 69 6c 69 74 79 2d 63'
       - '\| \| 0x68 65 63 6b 7d 7d 29 0a 20 20 20 20 2a 20 53 65'
       - '\| \| 0x63 75 72 65 20 42 6f 6f 74 20 28 7b 7b 74 65 6d'
       - '\| \| 0x70 6c 61 74 65 2d 73 65 63 75 72 65 2d 62 6f 6f'
       - '\| \| 0x74 7d 7d 29 0a 20 20 20 20 2a 20 46 69 72 6d 77'
       - '\| \| 0x61 72 65 20 44 6f 77 6e 6c 6f 61 64 20 28 7b 7b'
       - '\| \| 0x66 69 72 6d 77 61 72 65 2d 64 6f 77 6e 6c 6f 61'
       - '\| \| 0x64 2d 74 65 6d 70 6c 61 74 65 7d 7d 29 0a 20 20'
       - '\| \| 0x20 20 0a 20 20 20 20 54 68 69 73 20 65 78 61 6d'
       - '\| \| 0x70 6c 65 20 61 6c 73 6f 20 64 65 6d 6f 6e 73 74'
       - '\| \| 0x72 61 74 65 73 20 73 65 76 65 72 61 62 6c 65 20'
       - '\| \| 0x65 6c 65 6d 65 6e 74 73 20 28 7b 7b 6f 76 72 2d'
       - '\| \| 0x73 65 76 65 72 61 62 6c 65 7d 7d 29 2c 20 61 6e'
       - '\| \| 0x64 20 74 65 78 74 20 28 7b 7b 6d 61 6e 69 66 65'
       - '\| \| 0x73 74 2d 64 69 67 65 73 74 2d 74 65 78 74 7d 7d'
       - '\| \| 0x29 2e 81 41 00 a2 03 67 61 72 6d 2e 63 6f 6d 05'
       - '\| \| 0x78 52 54 68 69 73 20 63 6f 6d 70 6f 6e 65 6e 74'
       - '\| \| 0x20 69 73 20 61 20 64 65 6d 6f 6e 73 74 72 61 74'
       - '\| \| 0x69 6f 6e 2e 20 54 68 65 20 64 69 67 65 73 74 20'
       - '\| \| 0x69 73 20 61 20 73 61 6d 70 6c 65 20 70 61 74 74'
       - '\| \| 0x65 72 6e 2c 20 6e 6f 74 20 61 20 72 65 61 6c 20'
       - '\| \| 0x6f 6e 65 2e'
       - '\| \| 0xa2 \(2\)'
       - '\| \| \| 0x01 \(1\)'
       - '\| \| \| 0x79 01 9d \(413\)'
       - '"## Example 2: Simultaneous Download, Installation, Secure Boot, Severed Fields'
       - 'This example covers the following templates:'
       - '\* Compatibility Check \(\{\{template-compatibility-check\}\}\)'
       - '\* Secure Boot \(\{\{template-secure-boot\}\}\)'
       - '\* Firmware Download \(\{\{firmware-download-template\}\}\)'
       - 'This example also demonstrates severable elements \(\{\{ovr-severable\}\}\), and text \(\{\{manifest-digest-text\}\}\)\."'
       - '\| \| \| 0x81 \(1\)'
       - '\| \| \| \| 0x41 \(1\)'
       - '\| \| \| \| \| 0x00 \(0\)'
       - '\| \| \| 0xa2 \(2\)'
       - '\| \| \| \| 0x03 \(3\)'
       - '\| \| \| \| 0x67 \(7\)'
       - '\"arm.com\"'
       - '\| \| \| \| 0x05 \(5\)'
       - '\| \| \| \| 0x78 52 \(82\)'
       - '\"This component is a demonstration\. The digest is a sample pattern, not a real one\.\"'
  zcbor.unit.test4_print_cbor.colors:
    platform_allow: native_posix qemu_malta_be
    extra_args: ZCBOR_PRINT_CBOR=ON ZCBOR_PRINT_COLORS=ON
    tags: zcbor unit test4 print_cbor no_verbose colors
    timeout: 10
    harness: console
    harness_config:
      type: multi_line
      regex:
       - '.\[31m0x9f .\[34m.\[32m\(list\).\[0m'
       - '\| .\[31m0x00 .\[34m.\[32m\(0\).\[0m'
       - '\| .\[31m0x19 .\[34m0x12 34 .\[32m\(4660\).\[0m'
       - '\| .\[31m0x1b .\[34m0x00 00 00 02 4c b0 16 ea .\[32m\(9876543210\).\[0m'
       - '\| .\[31m0x58 .\[34m0x20 .\[32m\(bstr32\).\[0m'
       - '\| \| 0x01 23 45 67 89 ab cd ef fe dc ba 98 76 54 32 10'
       - '\| \| 0x00 11 22 33 44 55 66 77 88 99 aa bb cc dd ee ff'
       - '\| .\[31m0x6b .\[34m.\[32m\(tstr11\).\[0m'
       - '\| \| .Hello World.'
       - '\| .\[33m0x09 .\[33m0x1234 .\[31m0xf5 .\[34m.\[32m\(true\).\[0m'
       - '\| .\[31m0xf4 .\[34m.\[32m\(false\).\[0m'
       - '\| .\[31m0xf9 .\[34m0x42 48 .\[32m\(3.140625\).\[0m'
       - '\| .\[31m0xfa .\[34m0x41 28 00 00 .\[32m\(10.500000\).\[0m'
       - '\| .\[31m0xfb .\[34m0x40 29 66 66 66 66 66 66 .\[32m\(12.700000\).\[0m'
       - '\| .\[31m0xf6 .\[34m.\[32m\(nil\).\[0m'
       - '\| .\[31m0xf7 .\[34m.\[32m\(undefined\).\[0m'
       - '\| .\[31m0x40 .\[34m.\[32m\(bstr0\).\[0m'
       - '\| .\[31m0x9f .\[34m.\[32m\(list\).\[0m'
       - '\| \| .\[31m0xbf .\[34m.\[32m\(map\).\[0m'
       - '\| \| \| .\[31m0x64 .\[34m.\[32m\(tstr4\).\[0m'
       - '\| \| \| \| .Key0.'
       - '\| \| \| .\[31m0xfa .\[34m0x00 00 00 00 .\[32m\(0.000000\).\[0m'
       - '\| \| \| .\[31m0x01 .\[34m.\[32m\(1\).\[0m'
       - '\| \| \| .\[31m0x66 .\[34m.\[32m\(tstr6\).\[0m'
       - '\| \| \| \| .Value1.'
       - '\| \| .\[31m0xff .\[32m\(map end\).\[0m'
       - '\| .\[31m0xff .\[32m\(list end\).\[0m'
       - '.\[31m0xff .\[32m\(list end\).\[0m'
       - '.\[33m0x6b .\[31m0xa4 .\[34m.\[32m\(map4\).\[0m'
       - '\| .\[31m0x02 .\[34m.\[32m\(2\).\[0m'
       - '\| .\[31m0x58 .\[34m0x73 .\[32m\(bstr115\).\[0m'
       - '\| \| 0x82 58 24 82 2f 58 20 86 bb cc 88 23 f3 a4 44 19'
       - '\| \| 0x56 f0 2b 00 13 02 f5 03 48 74 61 fb 77 fa b0 86'
       - '\| \| 0xef e3 15 30 88 1f 97 58 4a d2 84 43 a1 01 26 a0'
       - '\| \| 0xf6 58 40 8c 6b f0 14 b6 2f a7 b8 0d d5 eb 2f f7'
       - '\| \| 0x02 4a b5 2a 11 6c d1 bc 0d b1 f1 03 11 b3 1e 7b'
       - '\| \| 0x29 e3 be ae 76 5f ad 42 fb 86 00 fa 13 a6 bf 6d'
       - '\| \| 0x5e 45 92 9a 05 a6 07 67 f9 b7 42 0a 50 02 a0 5d'
       - '\| \| 0x95 e4 9e'
       - '\| \| .\[31m0x82 .\[34m.\[32m\(list2\).\[0m'
       - '\| \| \| .\[31m0x58 .\[34m0x24 .\[32m\(bstr36\).\[0m'
       - '\| \| \| \| 0x82 2f 58 20 86 bb cc 88 23 f3 a4 44 19 56 f0 2b'
       - '\| \| \| \| 0x00 13 02 f5 03 48 74 61 fb 77 fa b0 86 ef e3 15'
       - '\| \| \| \| 0x30 88 1f 97'
       - '\| \| \| \| .\[31m0x82 .\[34m.\[32m\(list2\).\[0m'
       - '\| \| \| \| \| .\[31m0x2f .\[34m.\[32m\(-16\).\[0m'
       - '\| \| \| \| \| .\[31m0x58 .\[34m0x20 .\[32m\(bstr32\).\[0m'
       - '\| \| \| \| \| \| 0x86 bb cc 88 23 f3 a4 44 19 56 f0 2b 00 13 02 f5'
       - '\| \| \| \| \| \| 0x03 48 74 61 fb 77 fa b0 86 ef e3 15 30 88 1f 97'
       - '\| \| \| .\[31m0x58 .\[34m0x4a .\[32m\(bstr74\).\[0m'
       - '\| \| \| \| 0xd2 84 43 a1 01 26 a0 f6 58 40 8c 6b f0 14 b6 2f'
       - '\| \| \| \| 0xa7 b8 0d d5 eb 2f f7 02 4a b5 2a 11 6c d1 bc 0d'
       - '\| \| \| \| 0xb1 f1 03 11 b3 1e 7b 29 e3 be ae 76 5f ad 42 fb'
       - '\| \| \| \| 0x86 00 fa 13 a6 bf 6d 5e 45 92 9a 05 a6 07 67 f9'
       - '\| \| \| \| 0xb7 42 0a 50 02 a0 5d 95 e4 9e'
       - '\| \| \| \| .\[33m0x12 .\[31m0x84 .\[34m.\[32m\(list4\).\[0m'
       - '\| \| \| \| \| .\[31m0x43 .\[34m.\[32m\(bstr3\).\[0m'
       - '\| \| \| \| \| \| .\[31m0xa1 .\[34m.\[32m\(map1\).\[0m'
       - '\| \| \| \| \| \| \| .\[31m0x01 .\[34m.\[32m\(1\).\[0m'
       - '\| \| \| \| \| \| \| .\[31m0x26 .\[34m.\[32m\(-7\).\[0m'
       - '\| \| \| \| \| .\[31m0xa0 .\[34m.\[32m\(map0\).\[0m'
       - '\| \| \| \| \| .\[31m0xf6 .\[34m.\[32m\(nil\).\[0m'
       - '\| \| \| \| \| .\[31m0x58 .\[34m0x40 .\[32m\(bstr64\).\[0m'
       - '\| \| \| \| \| \| 0x8c 6b f0 14 b6 2f a7 b8 0d d5 eb 2f f7 02 4a b5'
       - '\| \| \| \| \| \| 0x2a 11 6c d1 bc 0d b1 f1 03 11 b3 1e 7b 29 e3 be'
       - '\| \| \| \| \| \| 0xae 76 5f ad 42 fb 86 00 fa 13 a6 bf 6d 5e 45 92'
       - '\| \| \| \| \| \| 0x9a 05 a6 07 67 f9 b7 42 0a 50 02 a0 5d 95 e4 9e'
       - '\| .\[31m0x03 .\[34m.\[32m\(3\).\[0m'
       - '\| .\[31m0x58 .\[34m0xbb .\[32m\(bstr187\).\[0m'
       - '\| \| 0xa7 01 01 02 02 03 58 5f a2 02 81 81 41 00 04 58'
       - '\| \| 0x56 86 14 a4 01 50 fa 6b 4a 53 d5 ad 5f df be 9d'
       - '\| \| 0xe6 63 e4 d4 1f fe 02 50 14 92 af 14 25 69 5e 48'
       - '\| \| 0xbf 42 9b 2d 51 f2 ab 45 03 58 24 82 2f 58 20 00'
       - '\| \| 0x11 22 33 44 55 66 77 88 99 aa bb cc dd ee ff 01'
       - '\| \| 0x23 45 67 89 ab cd ef fe dc ba 98 76 54 32 10 0e'
       - '\| \| 0x19 87 d0 01 0f 02 0f 07 43 82 03 0f 09 43 82 17'
       - '\| \| 0x02 11 82 2f 58 20 cf a9 0c 5c 58 59 5e 7f 51 19'
       - '\| \| 0xa7 2f 80 3f d0 37 0b 3e 6a bb ec 63 15 cd 38 f6'
       - '\| \| 0x31 35 28 1b c4 98 17 82 2f 58 20 2b fc 4d 0c c6'
       - '\| \| 0x68 0b e7 dd 9f 5c a3 0a a2 bb 5d 19 98 14 5d e3'
       - '\| \| 0x3d 54 10 1b 80 e2 ca 49 fa f9 18'
       - '\| \| .\[31m0xa7 .\[34m.\[32m\(map7\).\[0m'
       - '\| \| \| .\[31m0x01 .\[34m.\[32m\(1\).\[0m'
       - '\| \| \| .\[31m0x01 .\[34m.\[32m\(1\).\[0m'
       - '\| \| \| .\[31m0x02 .\[34m.\[32m\(2\).\[0m'
       - '\| \| \| .\[31m0x02 .\[34m.\[32m\(2\).\[0m'
       - '\| \| \| .\[31m0x03 .\[34m.\[32m\(3\).\[0m'
       - '\| \| \| .\[31m0x58 .\[34m0x5f .\[32m\(bstr95\).\[0m'
       - '\| \| \| \| 0xa2 02 81 81 41 00 04 58 56 86 14 a4 01 50 fa 6b'
       - '\| \| \| \| 0x4a 53 d5 ad 5f df be 9d e6 63 e4 d4 1f fe 02 50'
       - '\| \| \| \| 0x14 92 af 14 25 69 5e 48 bf 42 9b 2d 51 f2 ab 45'
       - '\| \| \| \| 0x03 58 24 82 2f 58 20 00 11 22 33 44 55 66 77 88'
       - '\| \| \| \| 0x99 aa bb cc dd ee ff 01 23 45 67 89 ab cd ef fe'
       - '\| \| \| \| 0xdc ba 98 76 54 32 10 0e 19 87 d0 01 0f 02 0f'
       - '\| \| \| \| .\[31m0xa2 .\[34m.\[32m\(map2\).\[0m'
       - '\| \| \| \| \| .\[31m0x02 .\[34m.\[32m\(2\).\[0m'
       - '\| \| \| \| \| .\[31m0x81 .\[34m.\[32m\(list1\).\[0m'
       - '\| \| \| \| \| \| .\[31m0x81 .\[34m.\[32m\(list1\).\[0m'
       - '\| \| \| \| \| \| \| .\[31m0x41 .\[34m.\[32m\(bstr1\).\[0m'
       - '\| \| \| \| \| \| \| \| .\[31m0x00 .\[34m.\[32m\(0\).\[0m'
       - '\| \| \| \| \| .\[31m0x04 .\[34m.\[32m\(4\).\[0m'
       - '\| \| \| \| \| .\[31m0x58 .\[34m0x56 .\[32m\(bstr86\).\[0m'
       - '\| \| \| \| \| \| 0x86 14 a4 01 50 fa 6b 4a 53 d5 ad 5f df be 9d e6'
       - '\| \| \| \| \| \| 0x63 e4 d4 1f fe 02 50 14 92 af 14 25 69 5e 48 bf'
       - '\| \| \| \| \| \| 0x42 9b 2d 51 f2 ab 45 03 58 24 82 2f 58 20 00 11'
       - '\| \| \| \| \| \| 0x22 33 44 55 66 77 88 99 aa bb cc dd ee ff 01 23'
       - '\| \| \| \| \| \| 0x45 67 89 ab cd ef fe dc ba 98 76 54 32 10 0e 19'
       - '\| \| \| \| \| \| 0x87 d0 01 0f 02 0f'
       - '\| \| \| \| \| \| .\[31m0x86 .\[34m.\[32m\(list6\).\[0m'
       - '\| \| \| \| \| \| \| .\[31m0x14 .\[34m.\[32m\(20\).\[0m'
       - '\| \| \| \| \| \| \| .\[31m0xa4 .\[34m.\[32m\(map4\).\[0m'
       - '\| \| \| \| \| \| \| \| .\[31m0x01 .\[34m.\[32m\(1\).\[0m'
       - '\| \| \| \| \| \| \| \| .\[31m0x50 .\[34m.\[32m\(bstr16\).\[0m'
       - '\| \| \| \| \| \| \| \| \| 0xfa 6b 4a 53 d5 ad 5f df be 9d e6 63 e4 d4 1f fe'
       - '\| \| \| \| \| \| \| \| .\[31m0x02 .\[34m.\[32m\(2\).\[0m'
       - '\| \| \| \| \| \| \| \| .\[31m0x50 .\[34m.\[32m\(bstr16\).\[0m'
       - '\| \| \| \| \| \| \| \| \| 0x14 92 af 14 25 69 5e 48 bf 42 9b 2d 51 f2 ab 45'
       - '\| \| \| \| \| \| \| \| .\[31m0x03 .\[34m.\[32m\(3\).\[0m'
       - '\| \| \| \| \| \| \| \| .\[31m0x58 .\[34m0x24 .\[32m\(bstr36\).\[0m'
       - '\| \| \| \| \| \| \| \| \| 0x82 2f 58 20 00 11 22 33 44 55 66 77 88 99 aa bb'
       - '\| \| \| \| \| \| \| \| \| 0xcc dd ee ff 01 23 45 67 89 ab cd ef fe dc ba 98'
       - '\| \| \| \| \| \| \| \| \| 0x76 54 32 10'
       - '\| \| \| \| \| \| \| \| \| .\[31m0x82 .\[34m.\[32m\(list2\).\[0m'
       - '\| \| \| \| \| \| \| \| \| \| .\[31m0x2f .\[34m.\[32m\(-16\).\[0m'
       - '\| \| \| \| \| \| \| \| \| \| .\[31m0x58 .\[34m0x20 .\[32m\(bstr32\).\[0m'
       - '\| \| \| \| \| \| \| \| \| \| \| 0x00 11 22 33 44 55 66 77 88 99 aa bb cc dd ee ff'
       - '\| \| \| \| \| \| \| \| \| \| \| 0x01 23 45 67 89 ab cd ef fe dc ba 98 76 54 32 10'
       - '\| \| \| \| \| \| \| \| .\[31m0x0e .\[34m.\[32m\(14\).\[0m'
       - '\| \| \| \| \| \| \| \| .\[31m0x19 .\[34m0x87 d0 .\[32m\(34768\).\[0m'
       - '\| \| \| \| \| \| \| .\[31m0x01 .\[34m.\[32m\(1\).\[0m'
       - '\| \| \| \| \| \| \| .\[31m0x0f .\[34m.\[32m\(15\).\[0m'
       - '\| \| \| \| \| \| \| .\[31m0x02 .\[34m.\[32m\(2\).\[0m'
       - '\| \| \| \| \| \| \| .\[31m0x0f .\[34m.\[32m\(15\).\[0m'
       - '\| \| \| .\[31m0x07 .\[34m.\[32m\(7\).\[0m'
       - '\| \| \| .\[31m0x43 .\[34m.\[32m\(bstr3\).\[0m'
       - '\| \| \| \| .\[31m0x82 .\[34m.\[32m\(list2\).\[0m'
       - '\| \| \| \| \| .\[31m0x03 .\[34m.\[32m\(3\).\[0m'
       - '\| \| \| \| \| .\[31m0x0f .\[34m.\[32m\(15\).\[0m'
       - '\| \| \| .\[31m0x09 .\[34m.\[32m\(9\).\[0m'
       - '\| \| \| .\[31m0x43 .\[34m.\[32m\(bstr3\).\[0m'
       - '\| \| \| \| .\[31m0x82 .\[34m.\[32m\(list2\).\[0m'
       - '\| \| \| \| \| .\[31m0x17 .\[34m.\[32m\(23\).\[0m'
       - '\| \| \| \| \| .\[31m0x02 .\[34m.\[32m\(2\).\[0m'
       - '\| \| \| .\[31m0x11 .\[34m.\[32m\(17\).\[0m'
       - '\| \| \| .\[31m0x82 .\[34m.\[32m\(list2\).\[0m'
       - '\| \| \| \| .\[31m0x2f .\[34m.\[32m\(-16\).\[0m'
       - '\| \| \| \| .\[31m0x58 .\[34m0x20 .\[32m\(bstr32\).\[0m'
       - '\| \| \| \| \| 0xcf a9 0c 5c 58 59 5e 7f 51 19 a7 2f 80 3f d0 37'
       - '\| \| \| \| \| 0x0b 3e 6a bb ec 63 15 cd 38 f6 31 35 28 1b c4 98'
       - '\| \| \| .\[31m0x17 .\[34m.\[32m\(23\).\[0m'
       - '\| \| \| .\[31m0x82 .\[34m.\[32m\(list2\).\[0m'
       - '\| \| \| \| .\[31m0x2f .\[34m.\[32m\(-16\).\[0m'
       - '\| \| \| \| .\[31m0x58 .\[34m0x20 .\[32m\(bstr32\).\[0m'
       - '\| \| \| \| \| 0x2b fc 4d 0c c6 68 0b e7 dd 9f 5c a3 0a a2 bb 5d'
       - '\| \| \| \| \| 0x19 98 14 5d e3 3d 54 10 1b 80 e2 ca 49 fa f9 18'
       - '\| .\[31m0x11 .\[34m.\[32m\(17\).\[0m'
       - '\| .\[31m0x58 .\[34m0x3c .\[32m\(bstr60\).\[0m'
       - '\| \| 0x86 14 a1 15 78 32 68 74 74 70 3a 2f 2f 65 78 61'
       - '\| \| 0x6d 70 6c 65 2e 63 6f 6d 2f 76 65 72 79 2f 6c 6f'
       - '\| \| 0x6e 67 2f 70 61 74 68 2f 74 6f 2f 66 69 6c 65 2f'
       - '\| \| 0x66 69 6c 65 2e 62 69 6e 15 02 03 0f'
       - '\| \| .\[31m0x86 .\[34m.\[32m\(list6\).\[0m'
       - '\| \| \| .\[31m0x14 .\[34m.\[32m\(20\).\[0m'
       - '\| \| \| .\[31m0xa1 .\[34m.\[32m\(map1\).\[0m'
       - '\| \| \| \| .\[31m0x15 .\[34m.\[32m\(21\).\[0m'
       - '\| \| \| \| .\[31m0x78 .\[34m0x32 .\[32m\(tstr50\).\[0m'
       - '\| \| \| \| \| .http://example.com/very/long/path/to/file/file.bin.'
       - '\| \| \| .\[31m0x15 .\[34m.\[32m\(21\).\[0m'
       - '\| \| \| .\[31m0x02 .\[34m.\[32m\(2\).\[0m'
       - '\| \| \| .\[31m0x03 .\[34m.\[32m\(3\).\[0m'
       - '\| \| \| .\[31m0x0f .\[34m.\[32m\(15\).\[0m'
       - '\| .\[31m0x17 .\[34m.\[32m\(23\).\[0m'
       - '\| .\[31m0x59 .\[34m0x02 04 .\[32m\(bstr516\).\[0m'
       - '\| \| 0xa2 01 79 01 9d 23 23 20 45 78 61 6d 70 6c 65 20'
       - '\| \| 0x32 3a 20 53 69 6d 75 6c 74 61 6e 65 6f 75 73 20'
       - '\| \| 0x44 6f 77 6e 6c 6f 61 64 2c 20 49 6e 73 74 61 6c'
       - '\| \| 0x6c 61 74 69 6f 6e 2c 20 53 65 63 75 72 65 20 42'
       - '\| \| 0x6f 6f 74 2c 20 53 65 76 65 72 65 64 20 46 69 65'
       - '\| \| 0x6c 64 73 0a 0a 20 20 20 20 54 68 69 73 20 65 78'
       - '\| \| 0x61 6d 70 6c 65 20 63 6f 76 65 72 73 20 74 68 65'
       - '\| \| 0x20 66 6f 6c 6c 6f 77 69 6e 67 20 74 65 6d 70 6c'
       - '\| \| 0x61 74 65 73 3a 0a 20 20 20 20 0a 20 20 20 20 2a'
       - '\| \| 0x20 43 6f 6d 70 61 74 69 62 69 6c 69 74 79 20 43'
       - '\| \| 0x68 65 63 6b 20 28 7b 7b 74 65 6d 70 6c 61 74 65'
       - '\| \| 0x2d 63 6f 6d 70 61 74 69 62 69 6c 69 74 79 2d 63'
       - '\| \| 0x68 65 63 6b 7d 7d 29 0a 20 20 20 20 2a 20 53 65'
       - '\| \| 0x63 75 72 65 20 42 6f 6f 74 20 28 7b 7b 74 65 6d'
       - '\| \| 0x70 6c 61 74 65 2d 73 65 63 75 72 65 2d 62 6f 6f'
       - '\| \| 0x74 7d 7d 29 0a 20 20 20 20 2a 20 46 69 72 6d 77'
       - '\| \| 0x61 72 65 20 44 6f 77 6e 6c 6f 61 64 20 28 7b 7b'
       - '\| \| 0x66 69 72 6d 77 61 72 65 2d 64 6f 77 6e 6c 6f 61'
       - '\| \| 0x64 2d 74 65 6d 70 6c 61 74 65 7d 7d 29 0a 20 20'
       - '\| \| 0x20 20 0a 20 20 20 20 54 68 69 73 20 65 78 61 6d'
       - '\| \| 0x70 6c 65 20 61 6c 73 6f 20 64 65 6d 6f 6e 73 74'
       - '\| \| 0x72 61 74 65 73 20 73 65 76 65 72 61 62 6c 65 20'
       - '\| \| 0x65 6c 65 6d 65 6e 74 73 20 28 7b 7b 6f 76 72 2d'
       - '\| \| 0x73 65 76 65 72 61 62 6c 65 7d 7d 29 2c 20 61 6e'
       - '\| \| 0x64 20 74 65 78 74 20 28 7b 7b 6d 61 6e 69 66 65'
       - '\| \| 0x73 74 2d 64 69 67 65 73 74 2d 74 65 78 74 7d 7d'
       - '\| \| 0x29 2e 81 41 00 a2 03 67 61 72 6d 2e 63 6f 6d 05'
       - '\| \| 0x78 52 54 68 69 73 20 63 6f 6d 70 6f 6e 65 6e 74'
       - '\| \| 0x20 69 73 20 61 20 64 65 6d 6f 6e 73 74 72 61 74'
       - '\| \| 0x69 6f 6e 2e 20 54 68 65 20 64 69 67 65 73 74 20'
       - '\| \| 0x69 73 20 61 20 73 61 6d 70 6c 65 20 70 61 74 74'
       - '\| \| 0x65 72 6e 2c 20 6e 6f 74 20 61 20 72 65 61 6c 20'
       - '\| \| 0x6f 6e 65 2e'
       - '\| \| .\[31m0xa2 .\[34m.\[32m\(map2\).\[0m'
       - '\| \| \| .\[31m0x01 .\[34m.\[32m\(1\).\[0m'
       - '\| \| \| .\[31m0x79 .\[34m0x01 9d .\[32m\(tstr413\).\[0m'
       - '\| \| \| \| .\#\# Example 2\: Simultaneous Download, Installation, Secure Boot, Severed Fields'
       - '\| \| \| \|'
       - '\| \| \| \|     This example covers the following templates\:'
       - '\| \| \| \|'
       - '\| \| \| \|     \* Compatibility Check \(\{\{template-compatibility-check\}\}\)'
       - '\| \| \| \|     \* Secure Boot \(\{\{template-secure-boot\}\}\)'
       - '\| \| \| \|     \* Firmware Download \(\{\{firmware-download-template\}\}\)'
       - '\| \| \| \|'
       - '\| \| \| \|     This example also demonstrates severable elements \(\{\{ovr-severable\}\}\), and text \(\{\{manifest-digest-text\}\}\)..'
       - '\| \| \| .\[31m0x81 .\[34m.\[32m\(list1\).\[0m'
       - '\| \| \| \| .\[31m0x41 .\[34m.\[32m\(bstr1\).\[0m'
       - '\| \| \| \| \| .\[31m0x00 .\[34m.\[32m\(0\).\[0m'
       - '\| \| \| .\[31m0xa2 .\[34m.\[32m\(map2\).\[0m'
       - '\| \| \| \| .\[31m0x03 .\[34m.\[32m\(3\).\[0m'
       - '\| \| \| \| .\[31m0x67 .\[34m.\[32m\(tstr7\).\[0m'
       - '\| \| \| \| \| .arm.com.'
       - '\| \| \| \| .\[31m0x05 .\[34m.\[32m\(5\).\[0m'
       - '\| \| \| \| .\[31m0x78 .\[34m0x52 .\[32m\(tstr82\).\[0m'
       - '\| \| \| \| \| .This component is a demonstration. The digest is a sample pattern, not a real one..'
```
