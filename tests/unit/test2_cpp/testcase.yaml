## zephyr/Kconfig
```kconfig
#
# Copyright (c) 2020 Nordic Semiconductor ASA
#
# SPDX-License-Identifier: LicenseRef-BSD-5-Clause-Nordic
#

config CDDL_GEN
	bool "Support code generated by cddl_gen"
```
