## CMakeLists.txt
```
#
# Copyright (c) 2023 Nordic Semiconductor ASA
#
# SPDX-License-Identifier: Apache-2.0
#

cmake_minimum_required(VERSION 3.13.1)

find_package(Zephyr REQUIRED HINTS $ENV{ZEPHYR_BASE})
project(test4_print_cbor)

set(REPO_ROOT ${CMAKE_CURRENT_LIST_DIR}/../../..)

include(${REPO_ROOT}/tests/cmake/test_template.cmake)

FILE(GLOB zcbor_sources ${REPO_ROOT}/src/*.c)
target_sources(app PRIVATE
  ${zcbor_sources})

target_include_directories(app PRIVATE ${REPO_ROOT}/include)

zephyr_compile_definitions(ZCBOR_STOP_ON_ERROR)
zephyr_compile_definitions(ZCBOR_PRINT_CBOR)
```

## prj.conf
```kconfig
#
# Copyright (c) 2023 Nordic Semiconductor ASA
#
# SPDX-License-Identifier: Apache-2.0
#

CONFIG_CBPRINTF_FP_SUPPORT=y
```

## src/main.c
```c
/*
 * Copyright (c) 2023 Nordic Semiconductor ASA
 *
 * SPDX-License-Identifier: Apache-2.0
 */

#include <zcbor_decode.h>
#include <zcbor_encode.h>
#include <zephyr/sys/printk.h>
#include <zephyr/kernel.h>


uint8_t suit_example[] = {
	0xd8, 0x6b, 0xa4, 0x02, 0x58, 0x73, 0x82, 0x58, 0x24, 0x82, 0x2f,
	0x58, 0x20, 0x86, 0xbb, 0xcc, 0x88, 0x23, 0xf3, 0xa4, 0x44, 0x19,
	0x56, 0xf0, 0x2b, 0x00, 0x13, 0x02, 0xf5, 0x03, 0x48, 0x74, 0x61,
	0xfb, 0x77, 0xfa, 0xb0, 0x86, 0xef, 0xe3, 0x15, 0x30, 0x88, 0x1f,
	0x97, 0x58, 0x4a, 0xd2, 0x84, 0x43, 0xa1, 0x01, 0x26, 0xa0, 0xf6,
	0x58, 0x40, 0x8c, 0x6b, 0xf0, 0x14, 0xb6, 0x2f, 0xa7, 0xb8, 0x0d,
	0xd5, 0xeb, 0x2f, 0xf7, 0x02, 0x4a, 0xb5, 0x2a, 0x11, 0x6c, 0xd1,
	0xbc, 0x0d, 0xb1, 0xf1, 0x03, 0x11, 0xb3, 0x1e, 0x7b, 0x29, 0xe3,
	0xbe, 0xae, 0x76, 0x5f, 0xad, 0x42, 0xfb, 0x86, 0x00, 0xfa, 0x13,
	0xa6, 0xbf, 0x6d, 0x5e, 0x45, 0x92, 0x9a, 0x05, 0xa6, 0x07, 0x67,
	0xf9, 0xb7, 0x42, 0x0a, 0x50, 0x02, 0xa0, 0x5d, 0x95, 0xe4, 0x9e,
	0x03, 0x58, 0xbb, 0xa7, 0x01, 0x01, 0x02, 0x02, 0x03, 0x58, 0x5f,
	0xa2, 0x02, 0x81, 0x81, 0x41, 0x00, 0x04, 0x58, 0x56, 0x86, 0x14,
	0xa4, 0x01, 0x50, 0xfa, 0x6b, 0x4a, 0x53, 0xd5, 0xad, 0x5f, 0xdf,
	0xbe, 0x9d, 0xe6, 0x63, 0xe4, 0xd4, 0x1f, 0xfe, 0x02, 0x50, 0x14,
	0x92, 0xaf, 0x14, 0x25, 0x69, 0x5e, 0x48, 0xbf, 0x42, 0x9b, 0x2d,
	0x51, 0xf2, 0xab, 0x45, 0x03, 0x58, 0x24, 0x82, 0x2f, 0x58, 0x20,
	0x00, 0x11, 0x22, 0x33, 0x44, 0x55, 0x66, 0x77, 0x88, 0x99, 0xaa,
	0xbb, 0xcc, 0xdd, 0xee, 0xff, 0x01, 0x23, 0x45, 0x67, 0x89, 0xab,
	0xcd, 0xef, 0xfe, 0xdc, 0xba, 0x98, 0x76, 0x54, 0x32, 0x10, 0x0e,
	0x19, 0x87, 0xd0, 0x01, 0x0f, 0x02, 0x0f, 0x07, 0x43, 0x82, 0x03,
	0x0f, 0x09, 0x43, 0x82, 0x17, 0x02, 0x11, 0x82, 0x2f, 0x58, 0x20,
	0xcf, 0xa9, 0x0c, 0x5c, 0x58, 0x59, 0x5e, 0x7f, 0x51, 0x19, 0xa7,
	0x2f, 0x80, 0x3f, 0xd0, 0x37, 0x0b, 0x3e, 0x6a, 0xbb, 0xec, 0x63,
	0x15, 0xcd, 0x38, 0xf6, 0x31, 0x35, 0x28, 0x1b, 0xc4, 0x98, 0x17,
	0x82, 0x2f, 0x58, 0x20, 0x2b, 0xfc, 0x4d, 0x0c, 0xc6, 0x68, 0x0b,
	0xe7, 0xdd, 0x9f, 0x5c, 0xa3, 0x0a, 0xa2, 0xbb, 0x5d, 0x19, 0x98,
	0x14, 0x5d, 0xe3, 0x3d, 0x54, 0x10, 0x1b, 0x80, 0xe2, 0xca, 0x49,
	0xfa, 0xf9, 0x18, 0x11, 0x58, 0x3c, 0x86, 0x14, 0xa1, 0x15, 0x78,
	0x32, 0x68, 0x74, 0x74, 0x70, 0x3a, 0x2f, 0x2f, 0x65, 0x78, 0x61,
	0x6d, 0x70, 0x6c, 0x65, 0x2e, 0x63, 0x6f, 0x6d, 0x2f, 0x76, 0x65,
	0x72, 0x79, 0x2f, 0x6c, 0x6f, 0x6e, 0x67, 0x2f, 0x70, 0x61, 0x74,
	0x68, 0x2f, 0x74, 0x6f, 0x2f, 0x66, 0x69, 0x6c, 0x65, 0x2f, 0x66,
	0x69, 0x6c, 0x65, 0x2e, 0x62, 0x69, 0x6e, 0x15, 0x02, 0x03, 0x0f,
	0x17, 0x59, 0x02, 0x04, 0xa2, 0x01, 0x79, 0x01, 0x9d, 0x23, 0x23,
	0x20, 0x45, 0x78, 0x61, 0x6d, 0x70, 0x6c, 0x65, 0x20, 0x32, 0x3a,
	0x20, 0x53, 0x69, 0x6d, 0x75, 0x6c, 0x74, 0x61, 0x6e, 0x65, 0x6f,
	0x75, 0x73, 0x20, 0x44, 0x6f, 0x77, 0x6e, 0x6c, 0x6f, 0x61, 0x64,
	0x2c, 0x20, 0x49, 0x6e, 0x73, 0x74, 0x61, 0x6c, 0x6c, 0x61, 0x74,
	0x69, 0x6f, 0x6e, 0x2c, 0x20, 0x53, 0x65, 0x63, 0x75, 0x72, 0x65,
	0x20, 0x42, 0x6f, 0x6f, 0x74, 0x2c, 0x20, 0x53, 0x65, 0x76, 0x65,
	0x72, 0x65, 0x64, 0x20, 0x46, 0x69, 0x65, 0x6c, 0x64, 0x73, 0x0a,
	0x0a, 0x20, 0x20, 0x20, 0x20, 0x54, 0x68, 0x69, 0x73, 0x20, 0x65,
	0x78, 0x61, 0x6d, 0x70, 0x6c, 0x65, 0x20, 0x63, 0x6f, 0x76, 0x65,
	0x72, 0x73, 0x20, 0x74, 0x68, 0x65, 0x20, 0x66, 0x6f, 0x6c, 0x6c,
	0x6f, 0x77, 0x69, 0x6e, 0x67, 0x20, 0x74, 0x65, 0x6d, 0x70, 0x6c,
	0x61, 0x74, 0x65, 0x73, 0x3a, 0x0a, 0x20, 0x20, 0x20, 0x20, 0x0a,
	0x20, 0x20, 0x20, 0x20, 0x2a, 0x20, 0x43, 0x6f, 0x6d, 0x70, 0x61,
	0x74, 0x69, 0x62, 0x69, 0x6c, 0x69, 0x74, 0x79, 0x20, 0x43, 0x68,
	0x65, 0x63, 0x6b, 0x20, 0x28, 0x7b, 0x7b, 0x74, 0x65, 0x6d, 0x70,
	0x6c, 0x61, 0x74, 0x65, 0x2d, 0x63, 0x6f, 0x6d, 0x70, 0x61, 0x74,
	0x69, 0x62, 0x69, 0x6c, 0x69, 0x74, 0x79, 0x2d, 0x63, 0x68, 0x65,
	0x63, 0x6b, 0x7d, 0x7d, 0x29, 0x0a, 0x20, 0x20, 0x20, 0x20, 0x2a,
	0x20, 0x53, 0x65, 0x63, 0x75, 0x72, 0x65, 0x20, 0x42, 0x6f, 0x6f,
	0x74, 0x20, 0x28, 0x7b, 0x7b, 0x74, 0x65, 0x6d, 0x70, 0x6c, 0x61,
	0x74, 0x65, 0x2d, 0x73, 0x65, 0x63, 0x75, 0x72, 0x65, 0x2d, 0x62,
	0x6f, 0x6f, 0x74, 0x7d, 0x7d, 0x29, 0x0a, 0x20, 0x20, 0x20, 0x20,
	0x2a, 0x20, 0x46, 0x69, 0x72, 0x6d, 0x77, 0x61, 0x72, 0x65, 0x20,
	0x44, 0x6f, 0x77, 0x6e, 0x6c, 0x6f, 0x61, 0x64, 0x20, 0x28, 0x7b,
	0x7b, 0x66, 0x69, 0x72, 0x6d, 0x77, 0x61, 0x72, 0x65, 0x2d, 0x64,
	0x6f, 0x77, 0x6e, 0x6c, 0x6f, 0x61, 0x64, 0x2d, 0x74, 0x65, 0x6d,
	0x70, 0x6c, 0x61, 0x74, 0x65, 0x7d, 0x7d, 0x29, 0x0a, 0x20, 0x20,
	0x20, 0x20, 0x0a, 0x20, 0x20, 0x20, 0x20, 0x54, 0x68, 0x69, 0x73,
	0x20, 0x65, 0x78, 0x61, 0x6d, 0x70, 0x6c, 0x65, 0x20, 0x61, 0x6c,
	0x73, 0x6f, 0x20, 0x64, 0x65, 0x6d, 0x6f, 0x6e, 0x73, 0x74, 0x72,
	0x61, 0x74, 0x65, 0x73, 0x20, 0x73, 0x65, 0x76, 0x65, 0x72, 0x61,
	0x62, 0x6c, 0x65, 0x20, 0x65, 0x6c, 0x65, 0x6d, 0x65, 0x6e, 0x74,
	0x73, 0x20, 0x28, 0x7b, 0x7b, 0x6f, 0x76, 0x72, 0x2d, 0x73, 0x65,
	0x76, 0x65, 0x72, 0x61, 0x62, 0x6c, 0x65, 0x7d, 0x7d, 0x29, 0x2c,
	0x20, 0x61, 0x6e, 0x64, 0x20, 0x74, 0x65, 0x78, 0x74, 0x20, 0x28,
	0x7b, 0x7b, 0x6d, 0x61, 0x6e, 0x69, 0x66, 0x65, 0x73, 0x74, 0x2d,
	0x64, 0x69, 0x67, 0x65, 0x73, 0x74, 0x2d, 0x74, 0x65, 0x78, 0x74,
	0x7d, 0x7d, 0x29, 0x2e, 0x81, 0x41, 0x00, 0xa2, 0x03, 0x67, 0x61,
	0x72, 0x6d, 0x2e, 0x63, 0x6f, 0x6d, 0x05, 0x78, 0x52, 0x54, 0x68,
	0x69, 0x73, 0x20, 0x63, 0x6f, 0x6d, 0x70, 0x6f, 0x6e, 0x65, 0x6e,
	0x74, 0x20, 0x69, 0x73, 0x20, 0x61, 0x20, 0x64, 0x65, 0x6d, 0x6f,
	0x6e, 0x73, 0x74, 0x72, 0x61, 0x74, 0x69, 0x6f, 0x6e, 0x2e, 0x20,
	0x54, 0x68, 0x65, 0x20, 0x64, 0x69, 0x67, 0x65, 0x73, 0x74, 0x20,
	0x69, 0x73, 0x20, 0x61, 0x20, 0x73, 0x61, 0x6d, 0x70, 0x6c, 0x65,
	0x20, 0x70, 0x61, 0x74, 0x74, 0x65, 0x72, 0x6e, 0x2c, 0x20, 0x6e,
	0x6f, 0x74, 0x20, 0x61, 0x20, 0x72, 0x65, 0x61, 0x6c, 0x20, 0x6f,
	0x6e, 0x65, 0x2e
};


int main(void)
{
	uint8_t payload[150] = {0};
	uint8_t bstr_ex[] = {0x01, 0x23, 0x45, 0x67, 0x89, 0xab, 0xcd, 0xef,
		 0xfe, 0xdc, 0xba, 0x98, 0x76, 0x54, 0x32, 0x10,
		 0x00, 0x11, 0x22, 0x33, 0x44, 0x55, 0x66, 0x77,
		 0x88, 0x99, 0xaa, 0xbb, 0xcc, 0xdd, 0xee, 0xff};

	ZCBOR_STATE_E(state_e, 3, payload, sizeof(payload), 0);
	ZCBOR_STATE_D(print_state1, 3, payload, sizeof(payload), 30, 0);
	ZCBOR_STATE_D(print_state2, 3, suit_example, sizeof(suit_example), 30, 0);

	state_e->constant_state->stop_on_error = true;

	zcbor_list_start_encode(state_e, 0);
	zcbor_int32_put(state_e, 0);
	zcbor_int32_put(state_e, 0x1234);
	zcbor_int64_put(state_e, 9876543210);
	zcbor_bstr_put_arr(state_e, bstr_ex);
	zcbor_tstr_put_lit(state_e, "Hello World");
	zcbor_tag_encode(state_e, &(uint32_t){9});
	zcbor_tag_put(state_e, 0x1234);
	zcbor_bool_put(state_e, true);
	zcbor_bool_put(state_e, false);
	zcbor_float16_put(state_e, 3.14);
	zcbor_float32_put(state_e, 10.5);
	zcbor_float64_put(state_e, 12.7);
	zcbor_nil_put(state_e, NULL);
	zcbor_undefined_put(state_e, NULL);
	zcbor_bstr_start_encode(state_e);
	zcbor_bstr_end_encode(state_e, NULL);
	zcbor_list_start_encode(state_e, 1);
	zcbor_map_start_encode(state_e, 2);
	zcbor_tstr_put_lit(state_e, "Key0");
	zcbor_float32_put(state_e, 0.0);
	zcbor_int32_put(state_e, 1);
	zcbor_tstr_put_lit(state_e, "Value1");
	zcbor_map_end_encode(state_e, 2);
	zcbor_list_end_encode(state_e, 1);
	bool ret = zcbor_list_end_encode(state_e, 0);

	if (!ret) {
		printk("Encode error: %d\r\n", zcbor_peek_error(state_e));
		return 1;
	}

	k_msleep(1);
	ret = zcbor_print_cbor(print_state1);

	if (!ret) {
		printk("Print error 1: %d\r\n", zcbor_peek_error(print_state1));
		return 1;
	}

	ret = zcbor_print_cbor(print_state2);

	if (!ret) {
		printk("Print error 2: %d\r\n", zcbor_peek_error(print_state2));
		return 1;
	}

	return 0;
}
```
